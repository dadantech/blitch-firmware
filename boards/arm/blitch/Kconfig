## boards/arm/blitch/Kconfig
```kconfig
# nRF52840 DK NRF52840 board configuration

# Copyright (c) 2016 Nordic Semiconductor ASA
# SPDX-License-Identifier: Apache-2.0

if BOARD_BLITCH

config BOARD_ENABLE_DCDC
	bool "DCDC mode"
	select SOC_DCDC_NRF52X
	default n

endif # BOARD_BLITCH
```

## boards/arm/blitch/Kconfig.defconfig
```kconfig
# Copyright (c) 2024 Nordic Semiconductor ASA
# SPDX-License-Identifier: Apache-2.0

if BOARD_BLITCH

config BOARD
	default "blitch"

config BT_CTLR
   default BT


endif
```

## boards/arm/blitch_prototype/Kconfig
```kconfig
# BC805M prototype board configuration

config BOARD_ENABLE_DCDC
	bool "DCDC mode"
	select SOC_DCDC_NRF52X
	default y
	depends on BOARD_BLITCH_PROTOTYPE
```

## boards/arm/blitch_prototype/Kconfig.defconfig
```kconfig
# Copyright (c) 2024 Nordic Semiconductor ASA
# SPDX-License-Identifier: Apache-2.0

if BOARD_BLITCH_PROTOTYPE

config BOARD
	default "blitch_prototype"

config BT_CTLR
   default BT


endif
```
